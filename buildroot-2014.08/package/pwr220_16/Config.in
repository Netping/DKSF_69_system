## buildroot-2014.08/package/pwr220_16/Config.in
```kconfig
config BR2_PACKAGE_PWR220_16
	bool "pwr220_16"
	default y
	help
	  NetPing Pwr220_16 control software.
```

## linux-3.9.11/drivers/iio/humidity/Kconfig
```kconfig
#
# humidity sensor drivers
#
menu "Humidity sensors"

config DHT11_GPIO
	tristate "DHT11 (and compatible sensors) driver"
	help
	  This driver supports reading data via a single interrupts
	  generating GPIO line. Currently tested are DHT11 and DHT22.
	  Other sensors should work as well as long as they speak the
	  same protocoll.

endmenu
```
